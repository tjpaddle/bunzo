## board/configs/bunzo_cm5_nano_a_defconfig
```kconfig
# bunzo — Raspberry Pi Compute Module 5 on Waveshare CM5-NANO-A.
#
# First real hardware target. Derived from Buildroot's upstream
# raspberrypi5_defconfig (BCM2712 / Cortex-A76 / rpi-6.6.y custom kernel)
# plus bunzo's standard systemd + Rust userland + rootfs overlay.
#
# Consumed via:
#   make BR2_EXTERNAL=$(bunzo_repo)/board \
#        O=$(bunzo_repo)/output/cm5_nano_a \
#        bunzo_cm5_nano_a_defconfig
#
# The Waveshare CM5-NANO-A is a third-party carrier. Baseline DTB assumed
# is the upstream CM5+CM5IO device tree; Waveshare-specific peripherals,
# if they block boot, will be addressed via dtoverlay= lines in config.txt
# rather than a new in-tree DTS.

# --- Target architecture (Cortex-A76 on BCM2712) ---
BR2_aarch64=y
BR2_cortex_a76=y

# --- Toolchain (built from source, glibc, C++ enabled) ---
BR2_TOOLCHAIN_BUILDROOT=y
BR2_TOOLCHAIN_BUILDROOT_GLIBC=y
BR2_TOOLCHAIN_BUILDROOT_CXX=y
BR2_PACKAGE_HOST_LINUX_HEADERS_CUSTOM_6_6=y

# --- System ---
BR2_INIT_SYSTEMD=y
BR2_SYSTEM_BIN_SH_BASH=y
BR2_TARGET_GENERIC_HOSTNAME="bunzo"
BR2_TARGET_GENERIC_ISSUE="bunzo 0.0.1"
# ttyAMA10 is the BCM2712 PL011 debug UART (pre-Pi5 boards used ttyAMA0).
# Exposed on the Waveshare debug header for developer/serial fallback;
# actual user setup UX is phone-over-Wi-Fi in M5.
BR2_TARGET_GENERIC_GETTY_PORT="ttyAMA10"
# Ethernet is present on CM5-NANO-A; DHCP on eth0 is a harmless fallback
# even on a Wi-Fi-first deployment. Wi-Fi comes up through provisioning
# mode (M5), not through Buildroot's ifupdown.
BR2_SYSTEM_DHCP="eth0"

# --- Rootfs overlay + post-build / post-image hooks ---
BR2_ROOTFS_OVERLAY="$(BR2_EXTERNAL_BUNZO_PATH)/bunzo/common/rootfs-overlay"
BR2_ROOTFS_POST_BUILD_SCRIPT="$(BR2_EXTERNAL_BUNZO_PATH)/bunzo/common/post-build.sh"
BR2_ROOTFS_POST_IMAGE_SCRIPT="$(BR2_EXTERNAL_BUNZO_PATH)/bunzo/cm5_nano_a/post-image.sh"

# --- Pi-side download integrity + upstream patch set ---
BR2_DOWNLOAD_FORCE_CHECK_HASHES=y
BR2_GLOBAL_PATCH_DIR="board/raspberrypi/patches"

# --- Kernel (Raspberry Pi rpi-6.6.y custom tarball, bcm2712 defconfig) ---
BR2_LINUX_KERNEL=y
BR2_LINUX_KERNEL_CUSTOM_TARBALL=y
BR2_LINUX_KERNEL_CUSTOM_TARBALL_LOCATION="$(call github,raspberrypi,linux,576cc10e1ed50a9eacffc7a05c796051d7343ea4)/linux-576cc10e1ed50a9eacffc7a05c796051d7343ea4.tar.gz"
BR2_LINUX_KERNEL_DEFCONFIG="bcm2712"
# Force 4K pages (upstream bcm2712 defaults to 16K, which breaks userland
# page-size assumptions) and layer bunzo's kernel fragment on top.
BR2_LINUX_KERNEL_CONFIG_FRAGMENT_FILES="board/raspberrypi/linux-4k-page-size.fragment $(BR2_EXTERNAL_BUNZO_PATH)/bunzo/common/linux.fragment"
BR2_LINUX_KERNEL_DTS_SUPPORT=y
# Upstream CM5-on-CM5IO device tree. The pinned rpi-6.6.y kernel commit
# (576cc10e) only ships the base bcm2712 stepping DTS; no bcm2712d0
# variant yet. If/when that lands we add it here.
BR2_LINUX_KERNEL_INTREE_DTS_NAME="broadcom/bcm2712-rpi-cm5-cm5io"
BR2_LINUX_KERNEL_NEEDS_HOST_OPENSSL=y

# --- Pi firmware package (installs DTBs + our config.txt / cmdline.txt) ---
# Pi 5 / CM5 boot from SPI EEPROM bootloader, not from bootcode.bin /
# start.elf / fixup.dat, so no BR2_PACKAGE_RPI_FIRMWARE_VARIANT_* flag.
BR2_PACKAGE_RPI_FIRMWARE=y
BR2_PACKAGE_RPI_FIRMWARE_CONFIG_FILE="$(BR2_EXTERNAL_BUNZO_PATH)/bunzo/cm5_nano_a/config.txt"
BR2_PACKAGE_RPI_FIRMWARE_CMDLINE_FILE="$(BR2_EXTERNAL_BUNZO_PATH)/bunzo/cm5_nano_a/cmdline.txt"
# DTB overlays not needed for first-boot bringup. Enable later if
# Waveshare peripherals require dtoverlay= entries.
# BR2_PACKAGE_RPI_FIRMWARE_INSTALL_DTB_OVERLAYS is not set

# --- CM5 onboard Wi-Fi + Bluetooth firmware (Cypress/Broadcom CYW43455) ---
BR2_PACKAGE_BRCMFMAC_SDIO_FIRMWARE_RPI=y
BR2_PACKAGE_BRCMFMAC_SDIO_FIRMWARE_RPI_WIFI=y
BR2_PACKAGE_BRCMFMAC_SDIO_FIRMWARE_RPI_BT=y

# --- Networking / provisioning primitives (consumed by bunzo-provisiond in M5) ---
BR2_PACKAGE_WPA_SUPPLICANT=y
BR2_PACKAGE_WPA_SUPPLICANT_NL80211=y
BR2_PACKAGE_HOSTAPD=y
BR2_PACKAGE_DNSMASQ=y
BR2_PACKAGE_IW=y
BR2_PACKAGE_WIRELESS_REGDB=y

# --- Userland packages (parity with QEMU target) ---
BR2_PACKAGE_BASH=y
BR2_PACKAGE_BUSYBOX_SHOW_OTHERS=y
BR2_PACKAGE_COREUTILS=y
BR2_PACKAGE_CA_CERTIFICATES=y
BR2_PACKAGE_HAVEGED=y
BR2_PACKAGE_KMOD=y
BR2_PACKAGE_KMOD_TOOLS=y
BR2_PACKAGE_OPENSSH=y
BR2_PACKAGE_SUDO=y
BR2_PACKAGE_UTIL_LINUX=y
BR2_PACKAGE_UTIL_LINUX_BINARIES=y
BR2_PACKAGE_XZ=y

# --- systemd sandboxing deps (enables +SECCOMP +AUDIT in systemd) ---
BR2_PACKAGE_LIBSECCOMP=y
BR2_PACKAGE_AUDIT=y
BR2_PACKAGE_SYSTEMD_LIBSECCOMP=y
BR2_PACKAGE_SYSTEMD_AUDIT=y

# --- Root filesystem (ext4 for mmcblk0p2 on the CM5 eMMC) ---
BR2_TARGET_ROOTFS_EXT2=y
BR2_TARGET_ROOTFS_EXT2_4=y
BR2_TARGET_ROOTFS_EXT2_SIZE="512M"
# No rootfs tarball — we flash sdcard.img directly.
# BR2_TARGET_ROOTFS_TAR is not set

# --- Host tools needed for image assembly + eMMC flashing ---
BR2_PACKAGE_HOST_DOSFSTOOLS=y
BR2_PACKAGE_HOST_GENIMAGE=y
BR2_PACKAGE_HOST_KMOD_XZ=y
BR2_PACKAGE_HOST_MTOOLS=y
# rpiboot for flashing CM5 eMMC over USB-C + BOOT button on CM5-NANO-A.
# The Linux builder gets this binary; macOS flashers install rpiboot
# separately (e.g. brew install rpiboot, or build from source at
# github.com/raspberrypi/usbboot).
BR2_PACKAGE_HOST_RASPBERRYPI_USBBOOT=y
```

## board/configs/bunzo_qemu_aarch64_defconfig
```kconfig
# bunzo QEMU aarch64 defconfig
#
# Builds bunzo for the QEMU `-M virt` aarch64 machine. This is the
# primary dev-loop target: fast to build, boots in seconds, same kernel
# sources as hardware targets.
#
# Consumed via:
#   make BR2_EXTERNAL=$(bunzo_repo)/board O=$(bunzo_repo)/output/qemu_aarch64 \
#        bunzo_qemu_aarch64_defconfig
#
# First-pass defconfig — expect 1-3 iterations after the first build run
# as Buildroot surfaces any missing or renamed symbols.

# --- Target architecture ---
BR2_aarch64=y
BR2_cortex_a53=y

# --- Toolchain (built from source, glibc, C++ enabled) ---
BR2_TOOLCHAIN_BUILDROOT=y
BR2_TOOLCHAIN_BUILDROOT_GLIBC=y
BR2_TOOLCHAIN_BUILDROOT_CXX=y

# --- System ---
BR2_INIT_SYSTEMD=y
BR2_SYSTEM_BIN_SH_BASH=y
BR2_TARGET_GENERIC_HOSTNAME="bunzo"
BR2_TARGET_GENERIC_ISSUE="bunzo 0.0.1"
BR2_TARGET_GENERIC_GETTY_PORT="ttyAMA0"
BR2_SYSTEM_DHCP="eth0"

# --- Rootfs overlay + post-build hook ---
BR2_ROOTFS_OVERLAY="$(BR2_EXTERNAL_BUNZO_PATH)/bunzo/common/rootfs-overlay"
BR2_ROOTFS_POST_BUILD_SCRIPT="$(BR2_EXTERNAL_BUNZO_PATH)/bunzo/common/post-build.sh"

# --- Kernel (Linux from kernel.org, aarch64 default config + our fragment) ---
BR2_LINUX_KERNEL=y
BR2_LINUX_KERNEL_LATEST_VERSION=y
BR2_LINUX_KERNEL_USE_ARCH_DEFAULT_CONFIG=y
BR2_LINUX_KERNEL_CONFIG_FRAGMENT_FILES="$(BR2_EXTERNAL_BUNZO_PATH)/bunzo/common/linux.fragment"
BR2_LINUX_KERNEL_IMAGE=y

# --- Userland packages ---
BR2_PACKAGE_BASH=y
BR2_PACKAGE_COREUTILS=y
BR2_PACKAGE_CA_CERTIFICATES=y
BR2_PACKAGE_HAVEGED=y
BR2_PACKAGE_OPENSSH=y
BR2_PACKAGE_PYTHON3=y
BR2_PACKAGE_SUDO=y
BR2_PACKAGE_UTIL_LINUX=y
BR2_PACKAGE_UTIL_LINUX_BINARIES=y

# --- Root filesystem (ext4 for QEMU virtio-blk boot) ---
BR2_TARGET_ROOTFS_EXT2=y
BR2_TARGET_ROOTFS_EXT2_4=y
BR2_TARGET_ROOTFS_EXT2_SIZE="512M"
```
